## CMakeLists.txt
```
# SPDX-License-Identifier: Apache-2.0

cmake_minimum_required(VERSION 3.13.1)

include($ENV{ZEPHYR_BASE}/cmake/app/boilerplate.cmake NO_POLICY_SCOPE)
project(SMP_MESH)

list(APPEND HEADERS
    "${PROJECT_SOURCE_DIR}/include/"
)

list(APPEND SOURCES
    "${PROJECT_SOURCE_DIR}/src/main.c"
    "${PROJECT_SOURCE_DIR}/src/mesh.c"
    "${PROJECT_SOURCE_DIR}/src/mesh_requests.c"
    "${PROJECT_SOURCE_DIR}/src/mesh_callbacks.c"
    "${PROJECT_SOURCE_DIR}/src/cmds.c"
    "${PROJECT_SOURCE_DIR}/src/mesh_dfu.c"
    "${PROJECT_SOURCE_DIR}/src/image.c"
)

zephyr_link_libraries_ifdef(CONFIG_FILE_SYSTEM_NFFS NFFS)
target_include_directories(app PRIVATE $ENV{ZEPHYR_BASE}/subsys/fs/nvs)

include_directories(${HEADERS})
target_sources(app PRIVATE ${SOURCES})
```

## prj.conf
```kconfig
#########################
####### DFU SETUP #######
#########################

CONFIG_STDOUT_CONSOLE=y
CONFIG_GPIO=n
CONFIG_USB=n
CONFIG_USB_DEVICE_STACK=n
CONFIG_USB_DEVICE_PRODUCT="Zephyr DFU sample"
CONFIG_USB_DFU_CLASS=n
CONFIG_FLASH=y
CONFIG_FLASH_MAP=y
CONFIG_FLASH_PAGE_LAYOUT=y

CONFIG_MPU_ALLOW_FLASH_WRITE=y
CONFIG_IMG_MANAGER=y
CONFIG_LOG=n
CONFIG_USB_DRIVER_LOG_LEVEL_ERR=n
CONFIG_USB_DEVICE_LOG_LEVEL_ERR=n
CONFIG_BOOTLOADER_MCUBOOT=y
CONFIG_IMG_ERASE_PROGRESSIVELY=y
CONFIG_BT_MESH_RX_SDU_MAX=384
CONFIG_BT_HCI_TX_STACK_SIZE=2048
CONFIG_MAIN_STACK_SIZE=1024
CONFIG_SYSTEM_WORKQUEUE_STACK_SIZE=4096

#########################
##### MCUMGR  SETUP #####
#########################

CONFIG_MCUMGR=y
CONFIG_MCUMGR_SMP_BT=n # Enable the Bluetooth and shell mcumgr transports.

# Enable all core commands.
CONFIG_MCUMGR_CMD_FS_MGMT=n
CONFIG_MCUMGR_CMD_IMG_MGMT=n
CONFIG_MCUMGR_CMD_OS_MGMT=n
CONFIG_MCUMGR_CMD_STAT_MGMT=n

#########################
###### SHELL SETUP ######
#########################

CONFIG_SHELL=y
CONFIG_KERNEL_SHELL=y

# Some command handlers require a large stack.

# Enable the NFFS file system.
CONFIG_FILE_SYSTEM=n
CONFIG_FILE_SYSTEM_NFFS=n

# Required by the `taskstat` command.
CONFIG_THREAD_MONITOR=y

# Enable statistics and statistic names.
CONFIG_STATS=n
CONFIG_STATS_NAMES=n

### nRF5 specific settings

# Specify the location of the NFFS file system.
CONFIG_FS_NFFS_FLASH_DEV_NAME="NRF_FLASH_DRV_NAME"

CONFIG_NVS=y
CONFIG_REBOOT=y

#########################
#### BLUETOOTH SETUP ####
#########################

CONFIG_BT_DEVICE_NAME="SMP_MESH"

CONFIG_BT_SETTINGS=y
CONFIG_FCB=y
CONFIG_SETTINGS=y
CONFIG_SETTINGS_FCB=y
CONFIG_BT_MESH_RPL_STORE_TIMEOUT=600

CONFIG_BOOT_BANNER=y

CONFIG_BT_OBSERVER=y
CONFIG_BT_BROADCASTER=y
CONFIG_BT_CTLR_DUP_FILTER_LEN=0
CONFIG_BT_CTLR_LE_ENC=n
CONFIG_BT_CTLR_LE_PING=n
CONFIG_BT_DATA_LEN_UPDATE=n
CONFIG_BT_PHY_UPDATE=n
CONFIG_BT_CTLR_CHAN_SEL_2=n
CONFIG_BT_CTLR_MIN_USED_CHAN=n
CONFIG_BT_CTLR_ADV_EXT=n
CONFIG_BT_CTLR_PRIVACY=n

CONFIG_BT_PERIPHERAL=y

CONFIG_BT=y
CONFIG_BT_TINYCRYPT_ECC=y
CONFIG_BT_RX_BUF_COUNT=60
CONFIG_BT_L2CAP_TX_MTU=512  
CONFIG_BT_RX_BUF_LEN=512
CONFIG_NET_BUF_USER_DATA_SIZE=16
CONFIG_BT_L2CAP_TX_BUF_COUNT=16

CONFIG_BT_MESH=y
CONFIG_BT_MESH_RELAY=y
CONFIG_BT_MESH_LOW_POWER=n
CONFIG_BT_MESH_FRIEND=n
CONFIG_BT_MESH_ADV_BUF_COUNT=256
CONFIG_BT_MESH_TX_SEG_MAX=32

CONFIG_BT_MESH_PB_GATT=y
CONFIG_BT_MESH_PB_ADV=y
CONFIG_BT_MESH_GATT_PROXY=y
CONFIG_BT_MESH_CFG_CLI=y

CONFIG_BT_MESH_SUBNET_COUNT=2
CONFIG_BT_MESH_APP_KEY_COUNT=2
CONFIG_BT_MESH_MODEL_KEY_COUNT=2
CONFIG_BT_MESH_MODEL_GROUP_COUNT=2
CONFIG_BT_MESH_LABEL_COUNT=3

CONFIG_BT_DEBUG_LOG=n
CONFIG_BT_MESH_DEBUG_ACCESS=n
CONFIG_BT_MESH_DEBUG=n

CONFIG_BT_RX_STACK_SIZE=8192
CONFIG_INIT_STACKS=n

CONFIG_BT_MAX_CONN=10
CONFIG_BT_CTLR_RX_BUFFERS=18
CONFIG_BT_CTLR_TX_BUFFERS=18
CONFIG_BT_HCI_CMD_COUNT=18

CONFIG_BT_ATT_PREPARE_COUNT=2
CONFIG_BT_MESH_RX_SEG_MSG_COUNT=24
CONFIG_BT_MESH_TX_SEG_MSG_COUNT=24
```

## src/main.c
```c
/*
 * Copyright (c) 2016 Intel Corporation
 * Copyright (c) 2017 Phytec Messtechnik GmbH
 *
 * SPDX-License-Identifier: Apache-2.0
 */

/* Sample app for USB DFU class driver. */

#include <assert.h>
#include <device.h>
#include <flash.h>
#include <logging/log.h>
#include <mgmt/buf.h>
#include <misc/reboot.h>
#include <nvs/nvs.h>
#include <stats.h>
#include <stdlib.h>
#include <string.h>
#include <zephyr.h>

#include "mesh.h"
#include "cmds.h"

#ifdef CONFIG_MCUMGR_CMD_FS_MGMT
#include <device.h>
#include <fs.h>
#include <nffs/nffs.h>

#include "fs_mgmt/fs_mgmt.h"
#endif
#ifdef CONFIG_MCUMGR_CMD_OS_MGMT
#include "os_mgmt/os_mgmt.h"
#endif
#ifdef CONFIG_MCUMGR_CMD_IMG_MGMT
#include "img_mgmt/img_mgmt.h"
#endif
#ifdef CONFIG_MCUMGR_CMD_STAT_MGMT
#include "stat_mgmt/stat_mgmt.h"
#endif

#ifdef CONFIG_MCUMGR_SMP_BT
#include <bluetooth/bluetooth.h>
#include <bluetooth/conn.h>
#include <bluetooth/gatt.h>
#include <mgmt/smp_bt.h>
#endif

/* Define an example stats group; approximates seconds since boot. */
STATS_SECT_START(smp_svr_stats)
STATS_SECT_ENTRY(ticks)
STATS_SECT_END;

/* Assign a name to the `ticks` stat. */
STATS_NAME_START(smp_svr_stats)
STATS_NAME(smp_svr_stats, ticks)
STATS_NAME_END(smp_svr_stats);

/* Define an instance of the stats group. */
STATS_SECT_DECL(smp_svr_stats) smp_svr_stats;

#ifdef CONFIG_MCUMGR_CMD_FS_MGMT
static struct nffs_flash_desc flash_desc;

static struct fs_mount_t nffs_mnt = {.type = FS_NFFS, .mnt_point = "/nffs", .fs_data = &flash_desc};
#endif

#ifdef CONFIG_MCUMGR_SMP_BT
static const struct bt_data ad[] = {
    BT_DATA_BYTES(BT_DATA_FLAGS, (BT_LE_AD_GENERAL | BT_LE_AD_NO_BREDR)),
    BT_DATA_BYTES(BT_DATA_UUID128_ALL, 0x84, 0xaa, 0x60, 0x74, 0x52, 0x8a, 0x8b, 0x86, 0xd3, 0x4c,
                  0xb7, 0x1d, 0x1d, 0xdc, 0x53, 0x8d),
};

static void advertise(void)
{
    int rc;

    bt_le_adv_stop();

    rc = bt_le_adv_start(BT_LE_ADV_CONN_NAME, ad, ARRAY_SIZE(ad), NULL, 0);
    if (rc) {
        printk("Advertising failed to start (rc %d)\n", rc);
        return;
    }

    printk("Advertising successfully started\n");
}

static void connected(struct bt_conn *conn, u8_t err)
{
    if (err) {
        printk("Connection failed (err %u)\n", err);
    } else {
        printk("Connected\n");
    }
}

static void disconnected(struct bt_conn *conn, u8_t reason)
{
    printk("Disconnected (reason %u)\n", reason);
    advertise();
}

static struct bt_conn_cb conn_callbacks = {
    .connected    = connected,
    .disconnected = disconnected,
};

#endif

void main(void)
{
#ifdef CONFIG_MCUMGR_CMD_FS_MGMT
    struct device *flash_dev;
#endif
    int rc;

    rc = STATS_INIT_AND_REG(smp_svr_stats, STATS_SIZE_32, "smp_svr_stats");
    assert(rc == 0);

    /* Register the built-in mcumgr command handlers. */
#ifdef CONFIG_MCUMGR_CMD_FS_MGMT
    flash_dev = device_get_binding(CONFIG_FS_NFFS_FLASH_DEV_NAME);
    if (!flash_dev) {
        printk("Error getting NFFS flash device binding\n");
    } else {
        /* set backend storage dev */
        nffs_mnt.storage_dev = flash_dev;

        rc = fs_mount(&nffs_mnt);
        if (rc < 0) {
            printk("Error mounting nffs [%d]\n", rc);
        }
    }

    fs_mgmt_register_group();
#endif
#ifdef CONFIG_MCUMGR_CMD_OS_MGMT
    os_mgmt_register_group();
#endif
#ifdef CONFIG_MCUMGR_CMD_IMG_MGMT
    img_mgmt_register_group();
#endif
#ifdef CONFIG_MCUMGR_CMD_STAT_MGMT
    stat_mgmt_register_group();
#endif

    /* Enable Bluetooth. */
    rc = bt_enable(bt_ready);

#ifdef CONFIG_MCUMGR_SMP_BT
    if (rc != 0) {
        printk("Bluetooth init failed (err %d)\n", rc);
        return;
    }
    bt_conn_cb_register(&conn_callbacks);

    /* Initialize the Bluetooth mcumgr transport. */
    smp_bt_register();
#endif

    /* The system work queue handles all incoming mcumgr requests.  Let the
     * main thread idle while the mcumgr server runs.
     */

    STATS_INC(smp_svr_stats, ticks);

    while (1) {
        k_sleep(5000);
    }
}
```

## include/cmds.h
```c
#ifndef _CMDS_H
#define _CMDS_H

#include <logging/log.h>
#include <misc/printk.h>
#include <misc/util.h>
#include <shell/shell.h>
#include <shell/shell_uart.h>
#include <stdlib.h>
#include <zephyr.h>

#include "mesh_dfu.h"

#endif // _CMDS_H
```

## include/image.h
```c
/*
 * Licensed to the Apache Software Foundation (ASF) under one
 * or more contributor license agreements.  See the NOTICE file
 * distributed with this work for additional information
 * regarding copyright ownership.  The ASF licenses this file
 * to you under the Apache License, Version 2.0 (the
 * "License"); you may not use this file except in compliance
 * with the License.  You may obtain a copy of the License at
 *
 *  http://www.apache.org/licenses/LICENSE-2.0
 *
 * Unless required by applicable law or agreed to in writing,
 * software distributed under the License is distributed on an
 * "AS IS" BASIS, WITHOUT WARRANTIES OR CONDITIONS OF ANY
 * KIND, either express or implied.  See the License for the
 * specific language governing permissions and limitations
 * under the License.
 */

#ifndef H_IMAGE_
#define H_IMAGE_

#include <inttypes.h>

#ifdef __ZEPHYR__
#include <toolchain/gcc.h>
#endif

#ifdef __cplusplus
extern "C" {
#endif

struct flash_area;

#define IMAGE_MAGIC 0x96f3b83d
#define IMAGE_MAGIC_V1 0x96f3b83c
#define IMAGE_MAGIC_NONE 0xffffffff
#define IMAGE_TLV_INFO_MAGIC 0x6907

#define IMAGE_HEADER_SIZE 32

/*
 * Image header flags.
 */
#define IMAGE_F_PIC 0x00000001          /* Not supported. */
#define IMAGE_F_NON_BOOTABLE 0x00000010 /* Split image app. */
#define IMAGE_F_ENCRYPTED 0x00000004    /* Encrypted. */
/*
 * Indicates that this image should be loaded into RAM instead of run
 * directly from flash.  The address to load should be in the
 * ih_load_addr field of the header.
 */
#define IMAGE_F_RAM_LOAD 0x00000020

/*
 * ECSDA224 is with NIST P-224
 * ECSDA256 is with NIST P-256
 */

/*
 * Image trailer TLV types.
 *
 * Signature is generated by computing signature over the image hash.
 * Currently the only image hash type is SHA256.
 *
 * Signature comes in the form of 2 TLVs.
 *   1st on identifies the public key which should be used to verify it.
 *   2nd one is the actual signature.
 */
#define IMAGE_TLV_KEYHASH 0x01     /* hash of the public key */
#define IMAGE_TLV_SHA256 0x10      /* SHA256 of image hdr and body */
#define IMAGE_TLV_RSA2048_PSS 0x20 /* RSA2048 of hash output */
#define IMAGE_TLV_ECDSA224 0x21    /* ECDSA of hash output */
#define IMAGE_TLV_ECDSA256 0x22    /* ECDSA of hash output */
#define IMAGE_TLV_RSA3072_PSS 0x23 /* RSA3072 of hash output */
#define IMAGE_TLV_ENC_RSA2048 0x30 /* Key encrypted with RSA-OAEP-2048 */
#define IMAGE_TLV_ENC_KW128 0x31   /* Key encrypted with AES-KW-128 */

struct image_version {
    uint8_t iv_major;
    uint8_t iv_minor;
    uint16_t iv_revision;
    uint32_t iv_build_num;
};

/** Image header.  All fields are in little endian byte order. */
struct image_header {
    uint32_t ih_magic;
    uint32_t ih_load_addr;
    uint16_t ih_hdr_size; /* Size of image header (bytes). */
    uint16_t _pad1;
    uint32_t ih_img_size; /* Does not include header. */
    uint32_t ih_flags;    /* IMAGE_F_[...]. */
    struct image_version ih_ver;
    uint32_t _pad2;
};

/** Image TLV header.  All fields in little endian. */
struct image_tlv_info {
    uint16_t it_magic;
    uint16_t it_tlv_tot; /* size of TLV area (including tlv_info header) */
};

/** Image trailer TLV format. All fields in little endian. */
struct image_tlv {
    uint8_t it_type; /* IMAGE_TLV_[...]. */
    uint8_t _pad;
    uint16_t it_len; /* Data length (not including TLV header). */
};

#define IS_ENCRYPTED(hdr) ((hdr)->ih_flags & IMAGE_F_ENCRYPTED)

#ifdef __ZEPHYR__
BUILD_ASSERT_MSG(sizeof(struct image_header) == IMAGE_HEADER_SIZE,
                 "struct image_header not required size");
#else
_Static_assert(sizeof(struct image_header) == IMAGE_HEADER_SIZE,
               "struct image_header not required size");
#endif

int cmp_version(struct image_version v1, struct image_version v2);

// int bootutil_img_validate(struct image_header *hdr, const struct flash_area *fap, uint8_t
// *tmp_buf,
//                           uint32_t tmp_buf_sz, uint8_t *seed, int seed_len, uint8_t *out_hash);

#ifdef __cplusplus
}
#endif

#endif
```

## include/mesh.h
```c
#ifndef _MESH_H
#define _MESH_H

#include <bluetooth/bluetooth.h>
#include <bluetooth/mesh.h>
#include <logging/log.h>
#include <misc/printk.h>
#include <settings/settings.h>

#include "mesh_callbacks.h"

int output_number(bt_mesh_output_action_t action, u32_t number);

void prov_complete(u16_t net_idx, u16_t addr);

void prov_reset(void);

void bt_ready(int err);

extern struct bt_mesh_model* dfu_srv_model;
extern struct bt_mesh_model* dfu_cli_model;

#endif  // _MESH_H
```

## include/mesh_callbacks.h
```c
#ifndef _BT_CALLBACKS_H
#define _BT_CALLBACKS_H

#include <bluetooth/bluetooth.h>
#include <bluetooth/mesh.h>
#include <logging/log.h>
#include <misc/printk.h>
#include <settings/settings.h>

#include "image.h"
#include "mesh_dfu.h"
#include "mesh_requests.h"

void dfu_get_property(struct bt_mesh_model *model, struct bt_mesh_msg_ctx *ctx,
                      struct net_buf_simple *buf);

void dfu_get_data(struct bt_mesh_model *model, struct bt_mesh_msg_ctx *ctx,
                  struct net_buf_simple *buf);

void dfu_status_property(struct bt_mesh_model *model, struct bt_mesh_msg_ctx *ctx,
                         struct net_buf_simple *buf);

void dfu_status_data(struct bt_mesh_model *model, struct bt_mesh_msg_ctx *ctx,
                     struct net_buf_simple *buf);

#endif  // _BT_CALLBACKS_H
```

## include/mesh_dfu.h
```c
/***************************************************************************
 *
 * Copyright(c) 2015,2016 Intel Corporation.
 * Copyright(c) 2017 PHYTEC Messtechnik GmbH
 *
 * Redistribution and use in source and binary forms, with or without
 * modification, are permitted provided that the following conditions
 * are met:
 *
 * * Redistributions of source code must retain the above copyright
 * notice, this list of conditions and the following disclaimer.
 * * Redistributions in binary form must reproduce the above copyright
 * notice, this list of conditions and the following disclaimer in
 * the documentation and/or other materials provided with the
 * distribution.
 * * Neither the name of Intel Corporation nor the names of its
 * contributors may be used to endorse or promote products derived
 * from this software without specific prior written permission.
 *
 * THIS SOFTWARE IS PROVIDED BY THE COPYRIGHT HOLDERS AND CONTRIBUTORS
 * "AS IS" AND ANY EXPRESS OR IMPLIED WARRANTIES, INCLUDING, BUT NOT
 * LIMITED TO, THE IMPLIED WARRANTIES OF MERCHANTABILITY AND FITNESS FOR
 * A PARTICULAR PURPOSE ARE DISCLAIMED. IN NO EVENT SHALL THE COPYRIGHT
 * OWNER OR CONTRIBUTORS BE LIABLE FOR ANY DIRECT, INDIRECT, INCIDENTAL,
 * SPECIAL, EXEMPLARY, OR CONSEQUENTIAL DAMAGES (INCLUDING, BUT NOT
 * LIMITED TO, PROCUREMENT OF SUBSTITUTE GOODS OR SERVICES; LOSS OF USE,
 * DATA, OR PROFITS; OR BUSINESS INTERRUPTION) HOWEVER CAUSED AND ON ANY
 * THEORY OF LIABILITY, WHETHER IN CONTRACT, STRICT LIABILITY, OR TORT
 * (INCLUDING NEGLIGENCE OR OTHERWISE) ARISING IN ANY WAY OUT OF THE USE
 * OF THIS SOFTWARE, EVEN IF ADVISED OF THE POSSIBILITY OF SUCH DAMAGE.
 *
 ***************************************************************************/

/**
 * @file
 * @brief USB Device Firmware Upgrade (DFU) public header
 *
 * Header follows the Device Class Specification for
 * Device Firmware Upgrade Version 1.1
 */

#ifndef ZEPHYR_INCLUDE_CLASS_MESH_DFU_H_
#define ZEPHYR_INCLUDE_CLASS_MESH_DFU_H_

#include <dfu/flash_img.h>
#include <dfu/mcuboot.h>
#include <errno.h>
#include <flash.h>
#include <flash_map.h>
#include <init.h>
#include <kernel.h>
#include <logging/log.h>
#include <misc/reboot.h>
#include <stdio.h>

#include "image.h"
#include "mesh_requests.h"

/* size of stack area used by each thread */
#define STACKSIZE 2048

/* scheduling priority used by each thread */
#define PRIORITY 7

enum dfu_status {
    OK_STATUS,
    ERRO_READ_STATUS,
    ERRO_WRITE_STATUS,
    ERRO_ERASE_STATUS,
    ERRO_CHECK_ERASED_STATUS,
    ERRO_VERIFY_STATUS,
};

enum dfu_state {
    IDLE_STATE,
    INIT_STATE,
    DOWNLOAD_STATE,
    BOOT_AND_VERIFY_STATE,
    ERROR_STATE,
};

enum dfu_event { DOWNLOAD_EVENT, RESPONSE_EVENT, TIMEOUT_EVENT, ABORT_EVENT };

/* Device data structure */

struct info_image {
    struct image_version version;
    u32_t image_size;
    u8_t flash_area_id;
    const struct flash_area *fap;
    // add bootable ?
};

struct dfu_data_t {
    struct info_image slots[NUM_OF_SLOTS];

    // Infos to update
    struct flash_img_context ctx;
    struct image_version version_update;
    u32_t image_size_update;
    u32_t offset_update;
    u16_t address_update;

    // Buffer
    u8_t buffer[SZ_DATA]; /* DFU data buffer */
    u16_t buffer_size;
    u32_t buffer_offset;

    // State machine
    enum dfu_state state;   /* State of the DFU device */
    enum dfu_status status; /* Status of the DFU device */
    u8_t timeout_events;
};

typedef struct {
    enum dfu_event event;
    u8_t buff[MAX_SIZE_DATA];
} msgq_dfu_event;

int match_version(struct image_version version);

u8_t get_state();

u8_t get_timeout_events();

void dfu_request(u8_t property);

void dfu_upload(u32_t offset);

void to_buffer(u8_t *data, u16_t data_size, u32_t offset);

u32_t bytes_written();

u16_t address_update();

u32_t image_size_update();

struct image_version get_update_image_version();

void reset_timeout();

extern struct k_msgq msgq_dfu;
extern struct k_mutex mutex_dfu;
// extern struct k_mutex dfu_upload_mutex;

#endif /* ZEPHYR_INCLUDE_USB_CLASS_USB_DFU_H_ */
```

## include/mesh_requests.h
```c
#ifndef _BT_REQUESTS_SMP_H
#define _BT_REQUESTS_SMP_H

#include <bluetooth/bluetooth.h>
#include <bluetooth/mesh.h>
#include <flash_map.h>
#include <logging/log.h>
#include <misc/printk.h>
#include <settings/settings.h>

#include "image.h"

#define NUM_OF_SLOTS 2
#define MAX_SIZE_DATA 300

/* Models from the Mesh Model to OTA in mesh */
#define BT_MESH_MODEL_ID_DFU_SRV 0x1234
#define BT_MESH_MODEL_ID_DFU_CLI 0x4321

#define CID_ZEPHYR 0x0002

#define SZ_VERSION 8
#define SZ_OFFSET 4
#define SZ_ADDRESS 2
#define SZ_DATA_SIZE 2
#define SZ_DATA 32
#define SZ_PROPERTY_SIZE 1
#define SZ_PROPERTY 12
#define TIME_TO_TIMEOUT K_SECONDS(5)
#define TIME_OF_TIMES 5

#define SZ_STATUS_PROPERTY SZ_PROPERTY_SIZE + SZ_PROPERTY
#define SZ_STATUS_DATA SZ_VERSION + SZ_OFFSET + SZ_DATA_SIZE + SZ_DATA
#define SZ_GET_PROPERTY SZ_PROPERTY_SIZE + SZ_DATA_SIZE
#define SZ_GET_DATA SZ_VERSION + SZ_OFFSET + SZ_ADDRESS


#define BT_MESH_MODEL_DFU_STATUS_PROPERTY BT_MESH_MODEL_OP_3(0x01, CID_ZEPHYR)
#define BT_MESH_MODEL_DFU_STATUS_DATA BT_MESH_MODEL_OP_3(0x02, CID_ZEPHYR)

#define BT_MESH_MODEL_DFU_GET_PROPERTY BT_MESH_MODEL_OP_3(0x03, CID_ZEPHYR)
#define BT_MESH_MODEL_DFU_GET_DATA BT_MESH_MODEL_OP_3(0x04, CID_ZEPHYR)

void send_dfu_get_data(u32_t offset, struct image_version version, u16_t address);
void send_dfu_get_property(u8_t property, u16_t address);

int send_dfu_status_data(u32_t offset, struct image_version version, u16_t data_size, u8_t *data);
void send_dfu_status_property(u8_t property, u8_t *data);
enum dfu_property { VERSION_PROPERTY, IMAGE_SIZE_PROPERTY, STATUS_PROPERTY };

extern struct bt_mesh_model *dfu_srv_model;
extern struct bt_mesh_model *dfu_cli_model;

#endif  // _BT_REQUESTS_SMP__H
```

## src/cmds.c
```c
#include "cmds.h"

// ######################              CMD DFU             ######################

static int cmd_mesh_send_dfu_property_status(const struct shell *shell, size_t argc, char **argv)
{
    u8_t id_property = atoi(argv[1]);
    dfu_request(id_property);
    return 0;
}

static int cmd_show_dfu_state(const struct shell *shell, size_t argc, char **argv)
{
    shell_print(shell, "My state is %d", get_state() );
    return 0;
}

static int cmd_show_dfu_timeout_events(const struct shell *shell, size_t argc, char **argv)
{
    shell_print(shell, "It happened timeout events %d", get_timeout_events() );
    return 0;
}


SHELL_STATIC_SUBCMD_SET_CREATE(
    sub_dfu, SHELL_CMD(send_property_status, NULL, "Send property of device.", cmd_mesh_send_dfu_property_status),
    SHELL_CMD(show_dfu_state, NULL, "Show dfu state.", cmd_show_dfu_state),
    SHELL_CMD(show_timeout_events, NULL, "Show timeout events.", cmd_show_dfu_timeout_events),
    SHELL_SUBCMD_SET_END);
SHELL_CMD_REGISTER(dfu, &sub_dfu, "Bluetooth commands", NULL);
```

## src/image.c
```c
#include "image.h"

int cmp_version(struct image_version v1, struct image_version v2)
{
    int major     = v1.iv_major - v2.iv_major;
    int minor     = v1.iv_minor - v2.iv_minor;
    int revision  = v1.iv_revision - v2.iv_revision;
    int build_num = v1.iv_build_num - v2.iv_build_num;

    if (major) {
        return major;
    }
    if (minor) {
        return minor;
    }
    if (revision) {
        return revision;
    }
    return build_num;
}
```

## src/mesh.c
```c
#include "mesh.h"

LOG_MODULE_REGISTER(BT_MESH);

static u8_t dev_uuid[16] = {0xdd, 0xda};

const struct bt_mesh_prov prov = {
    .uuid           = dev_uuid,
    .output_size    = 1,
    .output_actions = BT_MESH_DISPLAY_NUMBER,
    .output_number  = output_number,
    .complete       = prov_complete,
    .reset          = prov_reset,
};

/*
 * Server Configuration Declaration
 */

static struct bt_mesh_cfg_srv cfg_srv = {
    .relay  = BT_MESH_RELAY_DISABLED,
    .beacon = BT_MESH_BEACON_ENABLED,
#if defined(CONFIG_BT_MESH_FRIEND)
    .frnd = BT_MESH_FRIEND_ENABLED,
#else
    .frnd       = BT_MESH_FRIEND_NOT_SUPPORTED,
#endif
#if defined(CONFIG_BT_MESH_GATT_PROXY)
    .gatt_proxy = BT_MESH_GATT_PROXY_ENABLED,
#else
    .gatt_proxy = BT_MESH_GATT_PROXY_NOT_SUPPORTED,
#endif
    .default_ttl = 0,

    /* 3 transmissions with 20ms interval */
    .net_transmit     = BT_MESH_TRANSMIT(0, 20),
    .relay_retransmit = BT_MESH_TRANSMIT(0, 20),
};

static struct bt_mesh_health_srv health_srv = {};
static struct bt_mesh_cfg_cli cfg_cli       = {};

const struct bt_mesh_model_op dfu_cli_ops[] = {
    {BT_MESH_MODEL_DFU_STATUS_PROPERTY, SZ_STATUS_PROPERTY, dfu_status_property},
    {BT_MESH_MODEL_DFU_STATUS_DATA, SZ_STATUS_DATA, dfu_status_data},
    BT_MESH_MODEL_OP_END,
};

const struct bt_mesh_model_op dfu_srv_ops[] = {
    {BT_MESH_MODEL_DFU_GET_PROPERTY, SZ_GET_PROPERTY, dfu_get_property},
    {BT_MESH_MODEL_DFU_GET_DATA, SZ_GET_DATA, dfu_get_data},
    BT_MESH_MODEL_OP_END,
};

BT_MESH_MODEL_PUB_DEFINE(dfu_cli_pub, NULL, 3 + SZ_GET_DATA);
BT_MESH_MODEL_PUB_DEFINE(dfu_srv_pub, NULL, 3 + SZ_STATUS_DATA);
BT_MESH_HEALTH_PUB_DEFINE(health_pub, 0);

struct bt_mesh_model dfu_models[] = {
    BT_MESH_MODEL_VND(BT_COMP_ID_LF, BT_MESH_MODEL_ID_DFU_CLI, dfu_cli_ops, &dfu_cli_pub, NULL),
    BT_MESH_MODEL_VND(BT_COMP_ID_LF, BT_MESH_MODEL_ID_DFU_SRV, dfu_srv_ops, &dfu_srv_pub, NULL),
};

struct bt_mesh_model root_models[] = {
    BT_MESH_MODEL_CFG_SRV(&cfg_srv),
    BT_MESH_MODEL_CFG_CLI(&cfg_cli),
    BT_MESH_MODEL_HEALTH_SRV(&health_srv, &health_pub),
};

struct bt_mesh_elem elements[] = {
    BT_MESH_ELEM(0, root_models, dfu_models),
};

const struct bt_mesh_comp comp = {
    .cid        = BT_COMP_ID_LF,
    .elem       = elements,
    .elem_count = ARRAY_SIZE(elements),
};

int output_number(bt_mesh_output_action_t action, u32_t number)
{
    LOG_WRN("OOB Number: %u", number);
    printk("OOB Number: %u\n", number);
    return 0;
}

void prov_complete(u16_t net_idx, u16_t addr)
{
    LOG_INF("PROVISIONING WAS COMPLETED");
}

void prov_reset(void)
{
    LOG_INF("PROVISION RESET");
    bt_mesh_prov_enable(BT_MESH_PROV_ADV | BT_MESH_PROV_GATT);
}

void bt_ready(int err)
{
    LOG_INF("BT MESH INIT");
    struct bt_le_oob oob;

    if (err) {
        LOG_ERR("BT MESH INIT FAILD ERR: %d", err);
        return;
    }

    err = bt_mesh_init(&prov, &comp);
    if (err) {
        LOG_ERR("BT MESH INIT FAILED WITH ERR: %d", err);
        return;
    }

    if (IS_ENABLED(CONFIG_SETTINGS)) {
        settings_load();
    }

    /* Use identity address as device UUID */
    if (bt_le_oob_get_local(BT_ID_DEFAULT, &oob)) {
        LOG_ERR("Identity Address unavailable");
    } else {
        memcpy(dev_uuid, oob.addr.a.val, 6);
    }

    printk("UUID: ");
    for (size_t i = 0; i < 16; i++) {
        printk("%02x", dev_uuid[i]);
    }
    printk("\n");


    bt_mesh_prov_enable(BT_MESH_PROV_ADV | BT_MESH_PROV_GATT);
    LOG_INF("FINISH BT MESH INIT");
}

void counter_handler(struct k_timer* timer_id)
{
    LOG_ERR("COUNTER HANDLER");
}

struct bt_mesh_model* dfu_srv_model = &dfu_models[1];
struct bt_mesh_model* dfu_cli_model = &dfu_models[0];
```

## src/mesh_callbacks.c
```c
#include "mesh_callbacks.h"

LOG_MODULE_REGISTER(mesh_callbacks);

#define BROADCAST 0
#define BUTTON_DEBOUNCE_DELAY_MS 10000

static void get_version(struct image_version *version, struct net_buf_simple *buf)
{
    version->iv_major     = net_buf_simple_pull_u8(buf);
    version->iv_minor     = net_buf_simple_pull_u8(buf);
    version->iv_revision  = net_buf_simple_pull_le16(buf);
    version->iv_build_num = net_buf_simple_pull_le32(buf);
}

void dfu_get_property(struct bt_mesh_model *model, struct bt_mesh_msg_ctx *ctx,
                      struct net_buf_simple *buf)
{
    if (bt_mesh_model_elem(model)->addr == ctx->addr) {
        return;
    }

    u8_t property = net_buf_simple_pull_u8(buf);
    u16_t address = net_buf_simple_pull_le16(buf);

    if (address != BROADCAST && bt_mesh_model_elem(model)->addr != address) {
        printk("[WRN] Invalid address\n");
        return;
    }

    dfu_request(property);
}

void dfu_get_data(struct bt_mesh_model *model, struct bt_mesh_msg_ctx *ctx,
                  struct net_buf_simple *buf)
{
    if (bt_mesh_model_elem(model)->addr == ctx->addr) {
        return;
    }

    static u32_t last_time   = 0;
    static u32_t last_offset = -1;

    struct image_version version;
    u32_t offset;
    u16_t address;

    get_version(&version, buf);
    offset  = net_buf_simple_pull_le32(buf);
    address = net_buf_simple_pull_le16(buf);

    if (address != BROADCAST && bt_mesh_model_elem(model)->addr != address) {
        printk("[WRN] Wrong address\n");
        return;
    }
    printk("[INF] GET DATA - %d\n", offset);

    u32_t now = k_uptime_get_32();

    if ((offset == last_offset) && (last_time + K_SECONDS(10) >= now)) {
        printk("[WRN] Request same offset in little time\n");
        return;
    }

    if (!match_version(version)) {
        printk("[WRN] Wrong version\n");
        return;
    }

    last_offset = offset;

    printk("[INF] Request offset %d\n", offset);

    last_time = now;

    dfu_upload(offset);
}

void dfu_status_property(struct bt_mesh_model *model, struct bt_mesh_msg_ctx *ctx,
                         struct net_buf_simple *buf)
{
    if (bt_mesh_model_elem(model)->addr == ctx->addr) {
        return;
    }

    enum dfu_property property;
    int offset = 0;

    property = net_buf_simple_pull_u8(buf);

    // [1] Property +
    msgq_dfu_event q_event = {
        .event   = RESPONSE_EVENT,
        .buff[0] = property,
    };
    offset += 1;

    // + [2] Address
    memcpy(q_event.buff + offset, &ctx->addr, sizeof ctx->addr);
    offset += sizeof ctx->addr;

    switch (property) {
    case VERSION_PROPERTY:
        // + [8] Version
        printk("[INF] Version property\n");
        struct image_version version;
        get_version(&version, buf);
        memcpy(q_event.buff + offset, &version, sizeof version);
        break;
    case IMAGE_SIZE_PROPERTY:
        // + [4] Image size
        printk("[INF] Image size property\n");
        u32_t image_size = net_buf_simple_pull_le32(buf);
        memcpy(q_event.buff + offset, &image_size, sizeof image_size);
        break;
    case STATUS_PROPERTY:
        // + [1] Status
        printk("[INF] Status property\n");
        u8_t status = net_buf_simple_pull_u8(buf);
        memcpy(q_event.buff + offset, &status, sizeof status);
        break;
    default:
        printk("[ERR] Invalid property\n");
        return;
        break;
    }
    k_msgq_put(&msgq_dfu, &q_event, K_NO_WAIT);
}

void dfu_status_data(struct bt_mesh_model *model, struct bt_mesh_msg_ctx *ctx,
                     struct net_buf_simple *buf)
{
    printk("[DBG] STATUS DATA\n");
    if (bt_mesh_model_elem(model)->addr == ctx->addr) {
        return;
    }

    struct image_version version, update;
    static u8_t qt_offset_diff = 0;
    u32_t offset;
    u16_t data_size;
    u8_t data[SZ_DATA];

    get_version(&version, buf);
    update = get_update_image_version();

    u8_t match_major     = update.iv_major == version.iv_major;
    u8_t match_minor     = update.iv_minor == version.iv_minor;
    u8_t match_revision  = update.iv_revision == version.iv_revision;
    u8_t match_build_num = update.iv_build_num == version.iv_build_num;

    if (!(match_major & match_minor & match_revision & match_build_num)) {
        printk("[WRN] Wrong version\n");
        return;
    }

    offset    = net_buf_simple_pull_le32(buf);
    data_size = net_buf_simple_pull_le16(buf);

    if (bytes_written() != offset) {
        printk("[WRN] Offset diff: (%d)\n", offset);
        qt_offset_diff++;
        if( qt_offset_diff > 4 ){
            printk("[WRN] Request %d *\n", bytes_written());
            send_dfu_get_data(bytes_written(), update, BROADCAST);
        }
        return;
    }
    qt_offset_diff = 0;

    for (size_t i = 0; i < data_size; i++) {
        data[i] = net_buf_simple_pull_u8(buf);
    }

    if (k_mutex_lock(&mutex_dfu, K_NO_WAIT) == 0) {
        printk("[INF] Create download event\n");
        to_buffer(data, data_size, offset);
    }
}
```

## src/mesh_dfu.c
```c
#include "mesh_dfu.h"

LOG_MODULE_REGISTER(mesh_dfu);

static int read_image_info(int area_id, uint32_t *size, struct image_version *version)
{
    const struct flash_area *fap;
    struct image_tlv_info info;
    struct image_header hdr;
    int rc = 0;

    rc = flash_area_open(area_id, &fap);
    if (rc != 0) {
        rc = -1;
        goto done;
    }

    rc = flash_area_read(fap, 0, &hdr, sizeof(hdr));
    if (rc != 0) {
        rc = -1;
        goto done;
    }
    memcpy(version, &hdr.ih_ver, sizeof hdr.ih_ver);

    rc = flash_area_read(fap, hdr.ih_hdr_size + hdr.ih_img_size, &info, sizeof(info));
    if (rc != 0) {
        rc = -1;
        goto done;
    }

    if (info.it_magic != IMAGE_TLV_INFO_MAGIC) {
        rc = -1;
        goto done;
    }
    *size = hdr.ih_hdr_size + hdr.ih_img_size + info.it_tlv_tot;

done:
    flash_area_close(fap);
    return rc;
}

static struct dfu_data_t dfu_data = {
    .state                  = IDLE_STATE,
    .status                 = OK_STATUS,
    .timeout_events         = 0,
    .slots[0].flash_area_id = DT_FLASH_AREA_IMAGE_0_ID,
    .slots[1].flash_area_id = DT_FLASH_AREA_IMAGE_1_ID,
};

void timeout_function(struct k_timer *timer_id)
{
    dfu_data.timeout_events++;
    msgq_dfu_event q_event;

    if (dfu_data.timeout_events == TIME_OF_TIMES) {
        q_event.event  = ABORT_EVENT;
        dfu_data.state = ERROR_STATE;
        printk("[ERR] ERROR STATE\n");
    } else {
        q_event.event = TIMEOUT_EVENT;
    }
    printk("[WRN] CREATE TIMEOUT EVENT\n");
    k_msgq_put(&msgq_dfu, &q_event, K_NO_WAIT);
}

K_TIMER_DEFINE(timeout_timer, timeout_function, NULL);

typedef void (*state_func)(msgq_event);

typedef struct {
    state_func exec;
} state_function;

int match_version(struct image_version version)
{
    u8_t major     = version.iv_major == dfu_data.slots[0].version.iv_major;
    u8_t minor     = version.iv_minor == dfu_data.slots[0].version.iv_minor;
    u8_t revision  = version.iv_revision == dfu_data.slots[0].version.iv_revision;
    u8_t build_num = version.iv_build_num == dfu_data.slots[0].version.iv_build_num;
    return major & minor & revision & build_num;
}

struct image_version get_update_image_version()
{
    return dfu_data.version_update;
}

int up_version(struct image_version version)
{
    int major     = version.iv_major - dfu_data.slots[0].version.iv_major;
    int minor     = version.iv_minor - dfu_data.slots[0].version.iv_minor;
    int revision  = version.iv_revision - dfu_data.slots[0].version.iv_revision;
    int build_num = version.iv_build_num - dfu_data.slots[0].version.iv_build_num;

    if (major > 0) {
        return 1;
    } else if (!major && minor > 0) {
        return 1;
    } else if (!major && !minor && revision > 0) {
        return 1;
    } else if (!major && !minor && !revision && build_num > 0) {
        return 1;
    }
    return 0;
}

K_MSGQ_DEFINE(msgq_dfu, sizeof(msgq_dfu_event), 10, 4);

K_MUTEX_DEFINE(mutex_dfu);

K_MUTEX_DEFINE(dfu_upload_mutex);

#define min(x, y) (x < y ? x : y)

void to_buffer(u8_t *data, u16_t data_size, u32_t offset)
{
    if (dfu_data.state != DOWNLOAD_STATE) {
        printk("[ERR] It isn't download state\n");
        k_mutex_unlock(&mutex_dfu);
        return;
    }

    if (offset != dfu_data.offset_update) {
        printk("[WRN] Diff offset in process\n");
        k_mutex_unlock(&mutex_dfu);
        return;
    }

    printk("[INF] Write on flash %d bytes\n", data_size);
    if (flash_img_buffered_write(&dfu_data.ctx, data, data_size, false)) {
        printk("[ERR] DFU download: Write\n");
        dfu_data.state = ERROR_STATE;
    }
    k_timer_stop(&timeout_timer);

    dfu_data.offset_update += data_size;
    if (dfu_data.offset_update == dfu_data.image_size_update) {
        flash_img_buffered_write(&dfu_data.ctx, data, 0, true);
        dfu_data.state = BOOT_AND_VERIFY_STATE;
        k_mutex_unlock(&mutex_dfu);
        return;
    }

    printk("[INF] Request image segment from %d\n", dfu_data.offset_update);

    k_timer_start(&timeout_timer, TIME_TO_TIMEOUT, 0);
    dfu_data.timeout_events = 0;
    k_mutex_unlock(&mutex_dfu);
}

void reset_timeout()
{
    k_timer_stop(&timeout_timer);
    k_timer_start(&timeout_timer, TIME_TO_TIMEOUT, 0);
}

void dfu_request(u8_t property)
{
    u8_t data[12];

    switch (property) {
    case VERSION_PROPERTY:
        printk("[INF] REQUEST - VERSION\n");
        memcpy(data, &dfu_data.slots[0].version, sizeof dfu_data.slots[0].version);
        break;
    case IMAGE_SIZE_PROPERTY:
        printk("[INF] REQUEST - DATA_SIZE\n");
        memcpy(data, &dfu_data.slots[0].image_size, sizeof dfu_data.slots[0].image_size);
        break;
    case STATUS_PROPERTY:
        printk("[INF] REQUEST - STATUS\n");
        memcpy(data, &dfu_data.status, sizeof dfu_data.status);
        break;
    default:
        printk("[WRN] INVALID PROPERTY\n");
        return;
        break;
    }
    send_dfu_status_property(property, data);
}

void dfu_upload(u32_t offset)
{
    static u32_t offset_in = -1;
    static u8_t step = 0;

    printk("[INF] UPDATED OFFSET OF OFFSET\n");
    offset_in = offset;
    step = 0;


    if (k_mutex_lock(&dfu_upload_mutex, K_NO_WAIT)) {
        return;
    }

    u8_t buffer[SZ_DATA];
    u16_t data_size = 0;
    
    while (offset_in < dfu_data.slots[0].image_size) {
        data_size = min(dfu_data.slots[0].image_size - offset_in, SZ_DATA);
        if (flash_area_read(dfu_data.slots[0].fap, offset_in, buffer, data_size)) {
            printk("[ERR] DFU idle error in read\n");
            return;
        }

        if (send_dfu_status_data(offset_in, dfu_data.slots[0].version, data_size, buffer)) {
            break;
        }
        offset_in += data_size;
        k_sleep(K_SECONDS(1) + step*K_MSEC(100));
        step++;
        if( step > 10 )
        {
            step = 10;
        }
    }
    k_mutex_unlock(&dfu_upload_mutex);
}

void idle_process(msgq_dfu_event event)
{
    printk("[INF] DFU idle\n");

    if (event.event != RESPONSE_EVENT) {
        printk("[WRN] DFU idle: event isn't response type\n");
        return;
    }

    if (event.buff[0] != VERSION_PROPERTY) {
        printk("[WRN] DFU idle: property isn't version type\n");
        return;
    }

    struct image_version version;
    memcpy(&version, event.buff + 3, sizeof version);

    if (up_version(version)) {
        // Change state
        dfu_data.state = INIT_STATE;
        memcpy(&dfu_data.address_update, event.buff + 1, sizeof dfu_data.address_update);
        memcpy(&dfu_data.version_update, &version, sizeof dfu_data.version_update);

        // Request image size
        send_dfu_get_property(IMAGE_SIZE_PROPERTY, dfu_data.address_update);
        k_timer_start(&timeout_timer, TIME_TO_TIMEOUT, 0);
        dfu_data.timeout_events = 0;
    }
}

void init_process(msgq_dfu_event event)
{
    if (event.event != RESPONSE_EVENT) {
        printk("[WRN] DFU idle: event isn't response type\n");
        return;
    }

    if (event.buff[0] != IMAGE_SIZE_PROPERTY) {
        printk("[WRN] DFU idle: property isn't image size type\n");
        return;
    }

    u16_t address;
    memcpy(&address, event.buff + 1, sizeof address);

    if (address != dfu_data.address_update) {
        printk("[WRN] DFU idle: property isn't image size type\n");
        return;
    }

    memcpy(&dfu_data.image_size_update, event.buff + 3, sizeof dfu_data.image_size_update);
    dfu_data.state = DOWNLOAD_STATE;

    if (flash_img_init(&dfu_data.ctx)) {
        printk("[ERR] Init flash image\n");
        dfu_data.state = ERROR_STATE;
        return;
    }
    dfu_data.offset_update = 0;
    if (flash_area_erase(dfu_data.ctx.flash_area, 0, dfu_data.ctx.flash_area->fa_size)) {
        printk("[ERR] Erase flash\n");
        dfu_data.state = ERROR_STATE;
    }

    if (flash_img_bytes_written(&dfu_data.ctx)) {
        printk("[ERR] Buff in memory\n");
        dfu_data.state = ERROR_STATE;
        return;
    }

    k_timer_start(&timeout_timer, TIME_TO_TIMEOUT, 0);
    dfu_data.timeout_events = 0;

    printk("[INF] REQUEST FIRST IMAGE SEGMENTATION\n");
    send_dfu_get_data(dfu_data.offset_update, dfu_data.version_update, dfu_data.address_update);
}

void download_process(msgq_dfu_event event)
{
    printk("[INF] DFU DOWNLOAD\n");
    if (event.event != DOWNLOAD_EVENT) {
        printk("[ERR] Invalid event to this state\n");
        return;
    }
}

void verify_and_boot_process(msgq_dfu_event event)
{
    if (boot_request_upgrade(0)) {
        msgq_dfu_event q_event;
        q_event.event  = ABORT_EVENT;
        dfu_data.state = ERROR_STATE;
        k_msgq_put(&msgq_dfu, &q_event, K_FOREVER);
        return;
    }
    sys_reboot(SYS_REBOOT_COLD);
}

void error_process(msgq_dfu_event event)
{
    dfu_data.state = IDLE_STATE;
}

static int mesh_dfu_init(struct device *dev)
{
    printk("[INF] Mesh DFU init\n");

    printk("[INF] ###    INFORMATION     ###\n");
    for (size_t slot = 0; slot < 2; ++slot) {
        printk("[INF] *************************\n");
        printk("[INF] ***    Slot %d     ***\n", slot);
        // Setup
        read_image_info(dfu_data.slots[slot].flash_area_id, &dfu_data.slots[slot].image_size,
                        &dfu_data.slots[slot].version);
        if (flash_area_open(dfu_data.slots[slot].flash_area_id, &dfu_data.slots[slot].fap)) {
            printk("[ERR] Error opening\n");
            continue;
        }
        // Log
        printk("[INF] Image size: %d\n", dfu_data.slots[slot].image_size);
        printk("[INF] Version: %d.%d.%d+%d\n", dfu_data.slots[slot].version.iv_major,
               dfu_data.slots[slot].version.iv_minor, dfu_data.slots[slot].version.iv_revision,
               dfu_data.slots[slot].version.iv_build_num);
    }
    printk("[INF] ###########################\n");

    if (cmp_version(dfu_data.slots[0].version, dfu_data.slots[1].version) > 0) {
        //
        printk("[INF] Imagem confirmada\n");
        boot_is_img_confirmed();
    }

    static state_function funcs[] = {{idle_process},
                                     {init_process},
                                     {download_process},
                                     {verify_and_boot_process},
                                     {error_process}};

    static msgq_dfu_event event;
    while (1) {
        k_msgq_get(&msgq_dfu, &event, K_FOREVER);
        if (event.event == TIMEOUT_EVENT) {
            printk("[WRN] TIMEOUT EVENT\n");
            switch (dfu_data.state) {
            case INIT_STATE:
                // Requesitar o tamanho
                send_dfu_get_property(IMAGE_SIZE_PROPERTY, dfu_data.address_update);
                break;
            case DOWNLOAD_STATE:
                // Requesitar o segmento da imagem
                send_dfu_get_data(dfu_data.offset_update, dfu_data.version_update,
                                  dfu_data.address_update);
                break;
            default:
                break;
            }
            k_timer_start(&timeout_timer, (dfu_data.timeout_events + 1) * TIME_TO_TIMEOUT, 0);
        } else {
            funcs[dfu_data.state].exec(event);
        }
        k_sleep(K_MSEC(1));
    }

    return 0;
}

u8_t get_state()
{
    return dfu_data.state;
}

u8_t get_timeout_events()
{
    return dfu_data.timeout_events;
}

u32_t bytes_written()
{
    return dfu_data.offset_update;
}

u16_t address_update()
{
    return dfu_data.address_update;
}

u32_t image_size_update()
{
    return dfu_data.image_size_update;
}

K_THREAD_DEFINE(mesh_dfu, STACKSIZE, mesh_dfu_init, NULL, NULL, NULL, PRIORITY, 0, K_NO_WAIT);
```

## src/mesh_requests.c
```c
#include "mesh_requests.h"

LOG_MODULE_REGISTER(mesh_requests);

void send_dfu_get_data(u32_t offset, struct image_version version, u16_t address)
{
    LOG_DBG("DFU: get data\n");
    struct net_buf_simple *msg = dfu_cli_model->pub->msg;
    bt_mesh_model_msg_init(msg, BT_MESH_MODEL_DFU_GET_DATA);

    // [8] Version + [4] Offset + [2] Address
    net_buf_simple_add_u8(msg, version.iv_major);
    net_buf_simple_add_u8(msg, version.iv_minor);
    net_buf_simple_add_le16(msg, version.iv_revision);
    net_buf_simple_add_le32(msg, version.iv_build_num);
    net_buf_simple_add_le32(msg, offset);
    net_buf_simple_add_le32(msg, address);

    int err = bt_mesh_model_publish(dfu_cli_model);
    if (err) {
        printk("[ERR] BT MESH MODEL PUB ERR %d MESSAGE TO 0x%04x\n", err, dfu_cli_model->pub->addr);
    }
}

void send_dfu_get_property(u8_t property, u16_t address)
{
    LOG_DBG("DFU: get property\n");
    struct net_buf_simple *msg = dfu_cli_model->pub->msg;
    bt_mesh_model_msg_init(msg, BT_MESH_MODEL_DFU_GET_PROPERTY);

    // [1] Property + [2] Address
    net_buf_simple_add_u8(msg, property);
    net_buf_simple_add_le16(msg, address);

    int err = bt_mesh_model_publish(dfu_cli_model);
    if (err) {
        printk("[ERR] BT MESH MODEL PUB ERR %d MESSAGE TO 0x%04x\n", err, dfu_cli_model->pub->addr);
    }
}

void send_dfu_status_property(u8_t property, u8_t *data)
{
    printk("[INF] DFU: status property\n");
    struct net_buf_simple *msg = dfu_srv_model->pub->msg;
    bt_mesh_model_msg_init(msg, BT_MESH_MODEL_DFU_STATUS_PROPERTY);
    size_t bytes = 0;
    struct image_version version;
    u32_t image_size = 0;

    // [1] Property
    net_buf_simple_add_u8(msg, property);

    switch (property) {
    case VERSION_PROPERTY:  // [8] Version
        bytes = 8;
        printk("[INF] Send version\n");
        memcpy(&version, data, sizeof version);
        net_buf_simple_add_u8(msg, version.iv_major);
        net_buf_simple_add_u8(msg, version.iv_minor);
        net_buf_simple_add_le16(msg, version.iv_revision);
        net_buf_simple_add_le32(msg, version.iv_build_num);
        break;
    case IMAGE_SIZE_PROPERTY:  // [4] Data size
        bytes = 4;
        printk("[INF] Send image size\n");
        memcpy(&image_size, data, sizeof image_size);
        printk("[INF] Image size is %d\n", image_size);
        net_buf_simple_add_le32(msg, image_size);
        break;
    case STATUS_PROPERTY:  // [1] Status
        bytes = 1;
        printk("[INF] Send status\n");
        net_buf_simple_add_u8(msg, data[0]);
        break;
    default:
        break;
    }

    for (size_t i = bytes; i < 12; i++) {
        net_buf_simple_add_u8(msg, 0);
    }

    int err = bt_mesh_model_publish(dfu_srv_model);
    if (err) {
        printk("[ERR] BT MESH MODEL PUB ERR %d MESSAGE TO 0x%04x\n", err, dfu_srv_model->pub->addr);
    }
}

int send_dfu_status_data(u32_t offset, struct image_version version, u16_t data_size, u8_t *data)
{
    printk("[DBG] DFU STATUS DATA: With %d offset and %d data size\n", offset, data_size);
    struct net_buf_simple *msg = dfu_srv_model->pub->msg;
    bt_mesh_model_msg_init(msg, BT_MESH_MODEL_DFU_STATUS_DATA);

    // // [8] Version + [4] Offset + [2] Data size +
    net_buf_simple_add_u8(msg, version.iv_major);
    net_buf_simple_add_u8(msg, version.iv_minor);
    net_buf_simple_add_le16(msg, version.iv_revision);
    net_buf_simple_add_le32(msg, version.iv_build_num);
    net_buf_simple_add_le32(msg, offset);
    net_buf_simple_add_le16(msg, data_size);

    // // + [256] Data
    for (size_t i = 0; i < data_size; i++) {
        net_buf_simple_add_u8(msg, data[i]);
    }
    for (size_t i = data_size; i <= SZ_DATA; i++) {
        net_buf_simple_add_u8(msg, data[i]);
    }

    u8_t attempt = 0;

    while (bt_mesh_model_publish(dfu_srv_model))
    {
        k_sleep(K_MSEC(100));
        attempt++;
        if( attempt >= 5 ){
            printk("[ERR] Publish data status\n");
            return -1;
        }
    }
    return 0;
}
```
