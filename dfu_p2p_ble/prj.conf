## CMakeLists.txt
```
# SPDX-License-Identifier: Apache-2.0

cmake_minimum_required(VERSION 3.13.1)
set(BOARD_ROOT ${CMAKE_SOURCE_DIR}/../)
include($ENV{ZEPHYR_BASE}/cmake/app/boilerplate.cmake NO_POLICY_SCOPE)
project(central)

list(APPEND HEADERS
    "${PROJECT_SOURCE_DIR}/inc/"
)

list(APPEND SOURCES
    "${PROJECT_SOURCE_DIR}/src/main.c"
    "${PROJECT_SOURCE_DIR}/src/bt.c"
    "${PROJECT_SOURCE_DIR}/src/dfu_ble.c"
    "${PROJECT_SOURCE_DIR}/src/image.c"
)

include_directories(${HEADERS})
target_sources(app PRIVATE ${SOURCES})
```

## Kconfig
```
# Kconfig - nRF52 BEACON UPDATE board configuration
#
# Copyright (c) 2016 Nordic Semiconductor ASA
#
# SPDX-License-Identifier: Apache-2.0

config  BOARD_BEACON_UPDATE
	bool "BEACON_UPDATE"
	depends on SOC_NRF52832_QFAA

source "Kconfig.zephyr"
```

## prj.conf
```kconfig
#########################
#### BLUETOOTH SETUP ####
#########################

CONFIG_BT=y
CONFIG_BT_DEBUG_LOG=y
CONFIG_BT_DEBUG_MONITOR=n
CONFIG_BT_SMP=n
CONFIG_BT_CENTRAL=y
CONFIG_BT_GATT_CLIENT=y
CONFIG_BT_MAX_CONN=5
CONFIG_BT_DEVICE_NAME="ALFREDO1"
CONFIG_BT_PERIPHERAL=y
CONFIG_BT_CONN=y
CONFIG_BT_TINYCRYPT_ECC=y
CONFIG_BT_RX_BUF_COUNT=60
CONFIG_NET_BUF_USER_DATA_SIZE=16
CONFIG_BT_L2CAP_TX_BUF_COUNT=16

CONFIG_BT_RX_BUF_LEN=260
CONFIG_BT_L2CAP_TX_MTU=260
CONFIG_BT_L2CAP_RX_MTU=260
CONFIG_BT_ATT_TX_MAX=6
CONFIG_BT_GATT_DYNAMIC_DB=y
CONFIG_BT_CTLR_TX_BUFFER_SIZE=260
CONFIG_BT_CTLR_TX_PWR_PLUS_8=y
CONFIG_BT_PERIPHERAL_PREF_MIN_INT=6
CONFIG_BT_PERIPHERAL_PREF_MAX_INT=6
CONFIG_BT_PERIPHERAL_PREF_SLAVE_LATENCY=0
CONFIG_BT_PERIPHERAL_PREF_TIMEOUT=42

#########################
###### SHELL SETUP ######
#########################

CONFIG_SHELL=y
CONFIG_KERNEL_SHELL=y

#########################
####### DFU SETUP #######
#########################

CONFIG_FLASH=y
CONFIG_FLASH_MAP=y
CONFIG_FLASH_PAGE_LAYOUT=y

CONFIG_MPU_ALLOW_FLASH_WRITE=y
CONFIG_IMG_MANAGER=y
CONFIG_LOG=y
CONFIG_BOOTLOADER_MCUBOOT=y
CONFIG_IMG_ERASE_PROGRESSIVELY=y

# #########################
# ##### REBOOT  SETUP #####
# #########################

CONFIG_REBOOT=y
```

## inc/bt.h
```c
/** @file
 *  @brief Bluetooth shell functions
 *
 *  This is not to be included by the application.
 */

/*
 * Copyright (c) 2017 Intel Corporation
 *
 * SPDX-License-Identifier: Apache-2.0
 */

#ifndef __BT_H
#define __BT_H

#include <bluetooth/bluetooth.h>
#include <bluetooth/conn.h>
#include <errno.h>
#include <misc/byteorder.h>
#include <misc/printk.h>
#include <misc/util.h>
#include <settings/settings.h>
#include <stddef.h>
#include <stdlib.h>
#include <string.h>
#include <zephyr.h>
#include <zephyr/types.h>

// extern const struct shell *ctx_shell;
extern struct bt_conn *default_conn;

int str2bt_addr(const char *str, bt_addr_t *addr);
void conn_addr_str(struct bt_conn *conn, char *addr, size_t len);

int bt_init();

#endif /* __BT_H */
```

## inc/image.h
```c
/*
 * Licensed to the Apache Software Foundation (ASF) under one
 * or more contributor license agreements.  See the NOTICE file
 * distributed with this work for additional information
 * regarding copyright ownership.  The ASF licenses this file
 * to you under the Apache License, Version 2.0 (the
 * "License"); you may not use this file except in compliance
 * with the License.  You may obtain a copy of the License at
 *
 *  http://www.apache.org/licenses/LICENSE-2.0
 *
 * Unless required by applicable law or agreed to in writing,
 * software distributed under the License is distributed on an
 * "AS IS" BASIS, WITHOUT WARRANTIES OR CONDITIONS OF ANY
 * KIND, either express or implied.  See the License for the
 * specific language governing permissions and limitations
 * under the License.
 */

#ifndef H_IMAGE_
#define H_IMAGE_

#include <inttypes.h>

#ifdef __ZEPHYR__
#include <toolchain/gcc.h>
#endif

#ifdef __cplusplus
extern "C" {
#endif

struct flash_area;

#define IMAGE_MAGIC 0x96f3b83d
#define IMAGE_MAGIC_V1 0x96f3b83c
#define IMAGE_MAGIC_NONE 0xffffffff
#define IMAGE_TLV_INFO_MAGIC 0x6907

#define IMAGE_HEADER_SIZE 32

/*
 * Image header flags.
 */
#define IMAGE_F_PIC 0x00000001          /* Not supported. */
#define IMAGE_F_NON_BOOTABLE 0x00000010 /* Split image app. */
#define IMAGE_F_ENCRYPTED 0x00000004    /* Encrypted. */
/*
 * Indicates that this image should be loaded into RAM instead of run
 * directly from flash.  The address to load should be in the
 * ih_load_addr field of the header.
 */
#define IMAGE_F_RAM_LOAD 0x00000020

/*
 * ECSDA224 is with NIST P-224
 * ECSDA256 is with NIST P-256
 */

/*
 * Image trailer TLV types.
 *
 * Signature is generated by computing signature over the image hash.
 * Currently the only image hash type is SHA256.
 *
 * Signature comes in the form of 2 TLVs.
 *   1st on identifies the public key which should be used to verify it.
 *   2nd one is the actual signature.
 */
#define IMAGE_TLV_KEYHASH 0x01     /* hash of the public key */
#define IMAGE_TLV_SHA256 0x10      /* SHA256 of image hdr and body */
#define IMAGE_TLV_RSA2048_PSS 0x20 /* RSA2048 of hash output */
#define IMAGE_TLV_ECDSA224 0x21    /* ECDSA of hash output */
#define IMAGE_TLV_ECDSA256 0x22    /* ECDSA of hash output */
#define IMAGE_TLV_RSA3072_PSS 0x23 /* RSA3072 of hash output */
#define IMAGE_TLV_ENC_RSA2048 0x30 /* Key encrypted with RSA-OAEP-2048 */
#define IMAGE_TLV_ENC_KW128 0x31   /* Key encrypted with AES-KW-128 */

struct image_version {
    uint8_t iv_major;
    uint8_t iv_minor;
    uint16_t iv_revision;
    uint32_t iv_build_num;
};

/** Image header.  All fields are in little endian byte order. */
struct image_header {
    uint32_t ih_magic;
    uint32_t ih_load_addr;
    uint16_t ih_hdr_size; /* Size of image header (bytes). */
    uint16_t _pad1;
    uint32_t ih_img_size; /* Does not include header. */
    uint32_t ih_flags;    /* IMAGE_F_[...]. */
    struct image_version ih_ver;
    uint32_t _pad2;
};

/** Image TLV header.  All fields in little endian. */
struct image_tlv_info {
    uint16_t it_magic;
    uint16_t it_tlv_tot; /* size of TLV area (including tlv_info header) */
};

/** Image trailer TLV format. All fields in little endian. */
struct image_tlv {
    uint8_t it_type; /* IMAGE_TLV_[...]. */
    uint8_t _pad;
    uint16_t it_len; /* Data length (not including TLV header). */
};

#define IS_ENCRYPTED(hdr) ((hdr)->ih_flags & IMAGE_F_ENCRYPTED)

#ifdef __ZEPHYR__
BUILD_ASSERT_MSG(sizeof(struct image_header) == IMAGE_HEADER_SIZE,
                 "struct image_header not required size");
#else
_Static_assert(sizeof(struct image_header) == IMAGE_HEADER_SIZE,
               "struct image_header not required size");
#endif

int cmp_version(struct image_version *v1, struct image_version *v2);

int read_image_info(int area_id, uint32_t *size, struct image_version *version);

void print_version(struct image_version *ver);

#ifdef __cplusplus
}
#endif

#endif
```

## src/bt.c
```c
#include "bt.h"

#include <shell/shell.h>
#include <shell/shell_uart.h>

#include "dfu_ble.h"
#define DEVICE_NAME CONFIG_BT_DEVICE_NAME
#define DEVICE_NAME_LEN (sizeof(DEVICE_NAME) - 1)

#define HELP_NONE "[none]"
#define HELP_ADDR_LE "<address: XX:XX:XX:XX:XX:XX> <type: (public|random)>"

#define NAME_LEN 30
#define CHAR_SIZE_MAX 512

static u8_t selected_id = BT_ID_DEFAULT;

struct bt_conn *default_conn;

static const struct bt_data ad[] = {
    BT_DATA_BYTES(BT_DATA_FLAGS, (BT_LE_AD_GENERAL | BT_LE_AD_NO_BREDR)),
    BT_DATA_BYTES(BT_DATA_UUID128_ALL, 0x84, 0xaa, 0x60, 0x74, 0x52, 0x8a, 0x8b, 0x86, 0xd3, 0x4c,
                  0xb7, 0x1d, 0x1d, 0xdc, 0x53, 0x8d),
};

static bool data_cb(struct bt_data *data, void *user_data)
{
    char *name = user_data;

    switch (data->type) {
    case BT_DATA_NAME_SHORTENED:
    case BT_DATA_NAME_COMPLETE:
        memcpy(name, data->data, MIN(data->data_len, NAME_LEN - 1));
        return false;
    default:
        return true;
    }
}

static void device_found(const bt_addr_le_t *addr, s8_t rssi, u8_t evtype,
                         struct net_buf_simple *buf)
{
    char le_addr[BT_ADDR_LE_STR_LEN];
    char name[NAME_LEN];

    (void) memset(name, 0, sizeof(name));

    bt_data_parse(buf, data_cb, name);

    bt_addr_le_to_str(addr, le_addr, sizeof(le_addr));
    printk("[DEVICE]: %s, AD evt type %u, RSSI %i %s\n", le_addr, evtype, rssi, name);
}

static void advertise(void)
{
    int rc;

    bt_le_adv_stop();

    rc = bt_le_adv_start(BT_LE_ADV_CONN_NAME, ad, ARRAY_SIZE(ad), NULL, 0);
    if (rc) {
        printk("Advertising failed to start (rc %d)\n", rc);
        return;
    }

    printk("Advertising successfully started\n");
}

static void connected(struct bt_conn *conn, u8_t err)
{
    char addr[BT_ADDR_LE_STR_LEN];

    conn_addr_str(conn, addr, sizeof(addr));

    if (err) {
        printk("Failed to connect to %s (%u)\n", addr, err);
        // goto done;
    }

    printk("Connected: %s\n", addr);

    if (!default_conn) {
        default_conn = bt_conn_ref(conn);
    };

    if( err = dfu_connect(conn), err ){
        printk("Error (%d)\n", err);
    }

    // done:
    /* clear connection reference for sec mode 3 pairing */
    // if (pairing_conn) {
    // 	bt_conn_unref(pairing_conn);
    // 	pairing_conn = NULL;
    // }
}

static void disconnected(struct bt_conn *conn, u8_t reason)
{
    char addr[BT_ADDR_LE_STR_LEN];

    conn_addr_str(conn, addr, sizeof(addr));
    printk("Disconnected: %s (reason %u)\n", addr, reason);

    dfu_disconnect(conn);

    if (default_conn == conn) {
        bt_conn_unref(default_conn);
        default_conn = NULL;
    }
}

// static int char2hex(const char *c, u8_t *x)
// {
//     if (*c >= '0' && *c <= '9') {
//         *x = *c - '0';
//     } else if (*c >= 'a' && *c <= 'f') {
//         *x = *c - 'a' + 10;
//     } else if (*c >= 'A' && *c <= 'F') {
//         *x = *c - 'A' + 10;
//     } else {
//         return -EINVAL;
//     }

//     return 0;
// }

static int hexstr2array(const char *str, u8_t *array, u8_t size)
{
    int i, j;
    u8_t tmp;

    if (strlen(str) != ((size * 2U) + (size - 1))) {
        return -EINVAL;
    }

    for (i = size - 1, j = 1; *str != '\0'; str++, j++) {
        if (!(j % 3) && (*str != ':')) {
            return -EINVAL;
        } else if (*str == ':') {
            i--;
            continue;
        }

        array[i] = array[i] << 4;

        if (char2hex(*str, &tmp) < 0) {
            return -EINVAL;
        }

        array[i] |= tmp;
    }

    return 0;
}

int str2bt_addr(const char *str, bt_addr_t *addr)
{
    return hexstr2array(str, addr->val, 6);
}

void conn_addr_str(struct bt_conn *conn, char *addr, size_t len)
{
    struct bt_conn_info info;

    if (bt_conn_get_info(conn, &info) < 0) {
        addr[0] = '\0';
        return;
    }

    switch (info.type) {
#if defined(CONFIG_BT_BREDR)
    case BT_CONN_TYPE_BR:
        bt_addr_to_str(info.br.dst, addr, len);
        break;
#endif
    case BT_CONN_TYPE_LE:
        bt_addr_le_to_str(bt_conn_get_dst(conn), addr, len);
        break;
    }
}

static bool le_param_req(struct bt_conn *conn, struct bt_le_conn_param *param)
{
	printk("LE conn  param req: int (0x%04x, 0x%04x) lat %d"
		    " to %d\n", param->interval_min, param->interval_max,
		    param->latency, param->timeout);

	return true;
}

static void le_param_updated(struct bt_conn *conn, u16_t interval,
			     u16_t latency, u16_t timeout)
{
	printk("LE conn param updated: int 0x%04x lat %d "
		     "to %d\n", interval, latency, timeout);
}

static struct bt_conn_cb conn_callbacks = {
    .connected    = connected,
    .disconnected = disconnected,
    .le_param_req = le_param_req,
    .le_param_updated = le_param_updated,
};

static void bt_ready(int err)
{
    if (err) {
        printk("Bluetooth init failed (err %d)\n", err);
        return;
    }


    printk("Bluetooth initialized\n");

    if (IS_ENABLED(CONFIG_SETTINGS)) {
        settings_load();
    }

    default_conn = NULL;

    bt_conn_cb_register(&conn_callbacks);
    advertise();
}

int bt_init()
{
    int err = bt_enable(bt_ready);
    if (err) {
        printk("Bluetooth init failed (err %d)\n", err);
    }
    return err;
}

static int cmd_active_scan_on(const struct shell *shell, int dups)
{
    int err;
    struct bt_le_scan_param param = {.type       = BT_HCI_LE_SCAN_ACTIVE,
                                     .filter_dup = BT_HCI_LE_SCAN_FILTER_DUP_ENABLE,
                                     .interval   = BT_GAP_SCAN_FAST_INTERVAL,
                                     .window     = BT_GAP_SCAN_FAST_WINDOW};

    if (dups >= 0) {
        param.filter_dup = dups;
    }

    err = bt_le_scan_start(&param, device_found);
    if (err) {
        shell_error(shell,
                    "Bluetooth set active scan failed "
                    "(err %d)",
                    err);
        return err;
    } else {
        shell_print(shell, "Bluetooth active scan enabled");
    }

    return 0;
}

static int cmd_passive_scan_on(const struct shell *shell, int dups)
{
    struct bt_le_scan_param param = {.type       = BT_HCI_LE_SCAN_PASSIVE,
                                     .filter_dup = BT_HCI_LE_SCAN_FILTER_DUP_DISABLE,
                                     .interval   = 0x10,
                                     .window     = 0x10};
    int err;

    if (dups >= 0) {
        param.filter_dup = dups;
    }

    err = bt_le_scan_start(&param, device_found);
    if (err) {
        shell_error(shell,
                    "Bluetooth set passive scan failed "
                    "(err %d)",
                    err);
        return err;
    } else {
        shell_print(shell, "Bluetooth passive scan enabled");
    }

    return 0;
}

static int cmd_scan_off(const struct shell *shell)
{
    int err;

    err = bt_le_scan_stop();
    if (err) {
        shell_error(shell, "Stopping scanning failed (err %d)", err);
        return err;
    } else {
        shell_print(shell, "Scan successfully stopped");
    }

    return 0;
}

static int cmd_id_show(const struct shell *shell, size_t argc, char *argv[])
{
    bt_addr_le_t addrs[CONFIG_BT_ID_MAX];
    size_t i, count = CONFIG_BT_ID_MAX;

    bt_id_get(addrs, &count);

    for (i = 0; i < count; i++) {
        char addr_str[BT_ADDR_LE_STR_LEN];

        bt_addr_le_to_str(&addrs[i], addr_str, sizeof(addr_str));
        shell_print(shell, "%s%zu: %s", i == selected_id ? "*" : " ", i, addr_str);
    }

    return 0;
}

static int str2bt_addr_le(const char *str, const char *type, bt_addr_le_t *addr)
{
    int err;

    err = str2bt_addr(str, &addr->a);
    if (err < 0) {
        return err;
    }

    if (!strcmp(type, "public") || !strcmp(type, "(public)")) {
        addr->type = BT_ADDR_LE_PUBLIC;
    } else if (!strcmp(type, "random") || !strcmp(type, "(random)")) {
        addr->type = BT_ADDR_LE_RANDOM;
    } else {
        return -EINVAL;
    }

    return 0;
}

static int cmd_connect_le(const struct shell *shell, size_t argc, char *argv[])
{
    int err;
    bt_addr_le_t addr;
    struct bt_conn *conn;

    err = str2bt_addr_le(argv[1], argv[2], &addr);
    if (err) {
        shell_error(shell, "Invalid peer address (err %d)", err);
        return err;
    }

    conn = bt_conn_create_le(&addr, BT_LE_CONN_PARAM_DEFAULT);

    if (!conn) {
        shell_error(shell, "Connection failed");
        return -ENOEXEC;
    } else {
        shell_print(shell, "Connection pending");

        /* unref connection obj in advance as app user */
        bt_conn_unref(conn);
    }

    return 0;
}

static int cmd_disconnect(const struct shell *shell, size_t argc, char *argv[])
{
    struct bt_conn *conn;
    int err;

    if (default_conn && argc < 3) {
        conn = bt_conn_ref(default_conn);
    } else {
        bt_addr_le_t addr;

        if (argc < 3) {
            shell_help(shell);
            return SHELL_CMD_HELP_PRINTED;
        }

        err = str2bt_addr_le(argv[1], argv[2], &addr);
        if (err) {
            shell_error(shell, "Invalid peer address (err %d)", err);
            return err;
        }

        conn = bt_conn_lookup_addr_le(selected_id, &addr);
    }

    if (!conn) {
        shell_error(shell, "Not connected");
        return -ENOEXEC;
    }

    err = bt_conn_disconnect(conn, BT_HCI_ERR_REMOTE_USER_TERM_CONN);
    if (err) {
        shell_error(shell, "Disconnection failed (err %d)", err);
        return err;
    }

    bt_conn_unref(conn);

    return 0;
}

static int cmd_scan(const struct shell *shell, size_t argc, char *argv[])
{
    const char *action;
    int dups = -1;

    /* Parse duplicate filtering data */
    if (argc >= 3) {
        const char *dup_filter = argv[2];

        if (!strcmp(dup_filter, "dups")) {
            dups = BT_HCI_LE_SCAN_FILTER_DUP_DISABLE;
        } else if (!strcmp(dup_filter, "nodups")) {
            dups = BT_HCI_LE_SCAN_FILTER_DUP_ENABLE;
        } else {
            shell_help(shell);
            return SHELL_CMD_HELP_PRINTED;
        }
    }

    action = argv[1];
    if (!strcmp(action, "on")) {
        return cmd_active_scan_on(shell, dups);
    } else if (!strcmp(action, "off")) {
        return cmd_scan_off(shell);
    } else if (!strcmp(action, "passive")) {
        return cmd_passive_scan_on(shell, dups);
    } else {
        shell_help(shell);
        return SHELL_CMD_HELP_PRINTED;
    }

    return 0;
}

SHELL_STATIC_SUBCMD_SET_CREATE(bt_cmds,
                               SHELL_CMD_ARG(scan, NULL,
                                             "<value: on, passive, off> <dup filter: dups, nodups>",
                                             cmd_scan, 2, 1),
                               SHELL_CMD(id-show, NULL, "Show ids.", cmd_id_show),
                               SHELL_CMD_ARG(connect, NULL, HELP_ADDR_LE, cmd_connect_le, 3, 0),
                               SHELL_CMD_ARG(disconnect, NULL, HELP_NONE, cmd_disconnect, 1, 0),
                               SHELL_SUBCMD_SET_END);

static int cmd_bt(const struct shell *shell, size_t argc, char **argv)
{
    if (argc == 1) {
        shell_help(shell);
        return SHELL_CMD_HELP_PRINTED;
    }

    shell_error(shell, "%s unknown parameter: %s", argv[0], argv[1]);

    return -EINVAL;
}

SHELL_CMD_REGISTER(bt, &bt_cmds, "Bluetooth shell commands", cmd_bt);
```

## src/image.c
```c
#include "image.h"
#include <logging/log.h>
#include <dfu/flash_img.h>
#include <dfu/mcuboot.h>
#include <errno.h>
#include <flash.h>
#include <flash_map.h>

LOG_MODULE_REGISTER(image, 4);

int cmp_version(struct image_version *v1, struct image_version *v2)
{
    int major     = v1->iv_major - v2->iv_major;
    int minor     = v1->iv_minor - v2->iv_minor;
    int revision  = v1->iv_revision - v2->iv_revision;
    int build_num = v1->iv_build_num - v2->iv_build_num;

    if (major) {
        return major;
    }
    if (minor) {
        return minor;
    }
    if (revision) {
        return revision;
    }
    return build_num;
}

int read_image_info(int area_id, uint32_t *size, struct image_version *version)
{
    const struct flash_area *fap;
    struct image_tlv_info info;
    struct image_header hdr;
    int rc = 0;

    rc = flash_area_open(area_id, &fap);
    if (rc != 0) {
        rc = -1;
        goto done;
    }

    rc = flash_area_read(fap, 0, &hdr, sizeof(hdr));
    if (rc != 0) {
        rc = -1;
        goto done;
    }
    memcpy(version, &hdr.ih_ver, sizeof hdr.ih_ver);

    rc = flash_area_read(fap, hdr.ih_hdr_size + hdr.ih_img_size, &info, sizeof(info));
    if (rc != 0) {
        rc = -1;
        goto done;
    }

    if (info.it_magic != IMAGE_TLV_INFO_MAGIC) {
        rc = -1;
        goto done;
    }
    *size = hdr.ih_hdr_size + hdr.ih_img_size + info.it_tlv_tot;

done:
    flash_area_close(fap);
    return rc;
}

void print_version(struct image_version *ver)
{
    LOG_INF("Version: %d.%d.%d+%d", ver->iv_major, ver->iv_minor, ver->iv_revision,
            ver->iv_build_num);
}
```
